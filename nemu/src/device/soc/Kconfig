## nemu/src/device/soc/Kconfig
```kconfig
menuconfig SOC
  # depends on TARGET_SHARE
  bool "SoC Devices"
  default y
  help
    Provide device support for SoC NPC.

if SOC
menuconfig HAS_SRAM
  bool "Enable SRAM"
  default y

if HAS_SRAM
config SOC_SRAM_MMIO
  hex "MMIO address of SRAM"
  default 0x0f000000

config SOC_SRAM_SIZE
  hex "SRAM size (bytes)"
  default 0x2000
endif # SRAM

menuconfig HAS_MROM
  bool "Enable MROM"
  default y

if HAS_MROM
config SOC_MROM_MMIO
  hex "MMIO address of MROM"
  default 0x20000000

config SOC_MROM_SIZE
  hex "MROM size (bytes)"
  default 0x1000
endif # MROM

menuconfig HAS_FLASH
  bool "Enable FLASH"
  default y

if HAS_FLASH
config SOC_FLASH_MMIO
  hex "MMIO address of Flash"
  default 0x30000000

config SOC_FLASH_SIZE
  hex "Flash size (bytes)"
  default 0x8000
endif # Flash

# Serial device for SoC UART — enabled when DEVICE (which has its own
# serial) is unavailable (e.g. TARGET_SHARE / DiffTest ref mode).
menuconfig HAS_SERIAL
  bool "Enable serial (SoC UART)"
  default y
  depends on !DEVICE

if HAS_SERIAL && !DEVICE
config SERIAL_MMIO
  hex "MMIO address of SoC UART (serial)"
  default 0x10000000
endif # HAS_SERIAL && !DEVICE

endif # SOC
```
